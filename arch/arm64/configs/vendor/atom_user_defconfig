## arch/arm64/configs/vendor/atom_user_defconfig
```kconfig
# CONFIG_BLK_DEV_BSG is not set
# CONFIG_BOUNCE is not set
# CONFIG_CC_STACKPROTECTOR_STRONG is not set
# CONFIG_CFG80211_DEFAULT_PS is not set
# CONFIG_CORE_DUMP_DEFAULT_ELF_HEADERS is not set
# CONFIG_CRYPTO_HW is not set
# CONFIG_DEBUG_BUGVERBOSE is not set
# CONFIG_DEBUG_PREEMPT is not set
# CONFIG_DEVMEM is not set
# CONFIG_DRM_MEDIATEK_CANNON is not set
# CONFIG_EFI is not set
# CONFIG_ETHERNET is not set
# CONFIG_FHANDLE is not set
# CONFIG_GOODIX_CAP_FINGERPRINT is not set
# CONFIG_HWMON is not set
# CONFIG_INPUT_MOUSE is not set
# CONFIG_KALLSYMS_BASE_RELATIVE is not set
# CONFIG_KEYBOARD_ATKBD is not set
# CONFIG_MTK_CHARGER_BEGONIA is not set
# CONFIG_MTK_CHARGER_CANNON is not set
# CONFIG_MTK_CHARGER_CEZANNE is not set
# CONFIG_MTK_M4U is not set
# CONFIG_MTK_TYPEC_WATER_DETECT is not set
# CONFIG_MTK_TYPEC_WATER_DETECT_BY_PCB is not set
# CONFIG_NETWORK_FILESYSTEMS is not set
# CONFIG_RD_BZIP2 is not set
# CONFIG_RD_LZ4 is not set
# CONFIG_RD_LZMA is not set
# CONFIG_RD_LZO is not set
# CONFIG_RD_XZ is not set
# CONFIG_RTC_SYSTOHC is not set
# CONFIG_SLUB_DEBUG is not set
# CONFIG_SND_SPI is not set
# CONFIG_UEVENT_HELPER is not set
# CONFIG_VT is not set
#CONFIG_CUSTOM_KERNEL_BAROMETER is not set
#CONFIG_MTK_CAM_GENIEZONE_SUPPORT=y
CONFIG_ACCDET_EINT_IRQ=y
CONFIG_ACCDET_SUPPORT_EINT0=y
CONFIG_ANDROID_DEFAULT_SETTING=y
CONFIG_ANDROID_INTF_ALARM_DEV=y
CONFIG_ANDROID_PARANOID_NETWORK=n
CONFIG_ANDROID_SIMPLE_LMK_MINFREE=210
CONFIG_ANDROID_SIMPLE_LMK_TIMEOUT_MSEC=100
CONFIG_ANDROID_SIMPLE_LMK=y
CONFIG_ARCH_MTK_PROJECT="k6873v1_64"
CONFIG_AUFS_FS=y
CONFIG_AUTOFS4_FS=y
CONFIG_AW8624_XM_HAPTIC=y
CONFIG_BACKLIGHT_CLASS_DEVICE=y
CONFIG_BACKLIGHT_LCD_SUPPORT=y
CONFIG_BATT_VERIFY_BY_DS28E16=y
CONFIG_BATT_VERIFY=y
CONFIG_BLK_CGROUP=y
CONFIG_BLK_DEV_DM=y
CONFIG_BLK_DEV_LOOP_MIN_COUNT=16
CONFIG_BLK_DEV_SD=y
CONFIG_BLK_DEV_THROTTLING=y
CONFIG_BLK_INLINE_ENCRYPTION_FALLBACK=y
CONFIG_BLK_INLINE_ENCRYPTION=y
CONFIG_BLK_WBT_MQ=n
CONFIG_BLK_WBT_SQ=y
CONFIG_BLK_WBT=y
CONFIG_BPF_CGROUP_DEVICE=y
CONFIG_BQ2597X_CHARGE_PUMP=y
CONFIG_BRIDGE_NETFILTER=y
CONFIG_BRIDGE_VLAN_FILTERING=y
CONFIG_BRIDGE=y
CONFIG_BTRFS_FS_POSIX_ACL=y
CONFIG_BTRFS_FS=y
CONFIG_BUILD_ARM64_APPENDED_DTB_IMAGE_NAMES="mediatek/mt6873"
CONFIG_BUILD_ARM64_APPENDED_DTB_IMAGE=y
CONFIG_BUILD_ARM64_DT_OVERLAY=y
CONFIG_CFG80211_DEVELOPER_WARNINGS=y
CONFIG_CFG80211_INTERNAL_REGDB=y
CONFIG_CFG80211=y
CONFIG_CFQ_GROUP_IOSCHED=y
CONFIG_CFS_BANDWIDTH=y
CONFIG_CGROUP_BPF=y
CONFIG_CGROUP_CPU=y
CONFIG_CGROUP_CPUACCT=y
CONFIG_CGROUP_CPUSET=y
CONFIG_CGROUP_DEVICE=y
CONFIG_CGROUP_FREEZER=y
CONFIG_CGROUP_HUGETLB=y
CONFIG_CGROUP_IO=y
CONFIG_CGROUP_MEM_RES_CTLR_SWAP=y
CONFIG_CGROUP_MEM_RES_CTLR=y
CONFIG_CGROUP_MEMORY=y
CONFIG_CGROUP_NET_CLASSID=y
CONFIG_CGROUP_NET_PRIO=y
CONFIG_CGROUP_PERF=y
CONFIG_CGROUP_PIDS=y
CONFIG_CGROUP_RDMA=y
CONFIG_CGROUP_SCHED=y
CONFIG_CGROUP_SYSTEMD=y
CONFIG_CGROUPS=y
CONFIG_CHECKPOINT_RESTORE=y
CONFIG_CLS_U32_MARK=y
CONFIG_CLS_U32_PERF=y
CONFIG_CMDLINE="console=tty0 console=ttyMT3,921600n1 root=/dev/ram vmalloc=496M slub_max_order=0 slub_debug=O "
CONFIG_COMPAT=y
CONFIG_CPU_FREQ_DEFAULT_GOV_SCHEDUTIL=y
CONFIG_CPU_FREQ_GOV_ONDEMAND=y
CONFIG_CPU_FREQ_GOV_POWERSAVE=y
CONFIG_CPU_FREQ_GOV_USERSPACE=y
CONFIG_CPU_FREQ_STAT=y
CONFIG_CPU_FREQ=y
CONFIG_CPU_SUP_INTEL=y
CONFIG_CPU_THERMAL=y
CONFIG_CPUSETS=y
CONFIG_CRC8=y
CONFIG_CROSS_COMPILE="aarch64-linux-android-"
CONFIG_CRYPTO_AEAD=y
CONFIG_CRYPTO_GCM=y
CONFIG_CRYPTO_GHASH=y
CONFIG_CRYPTO_GHASH=y 
CONFIG_CRYPTO_SEQIV=y
CONFIG_CRYPTO_TWOFISH=y
CONFIG_CRYPTO=y
CONFIG_CRYPTO=y 
CONFIG_CUSTOM_KERNEL_ACCELEROMETER=y
CONFIG_CUSTOM_KERNEL_ALSPS=y
CONFIG_CUSTOM_KERNEL_CAM_CAL_DRV="BRCB032GWZ_3 GT24c32a cat24c16"
CONFIG_CUSTOM_KERNEL_GMRV_SENSOR=y
CONFIG_CUSTOM_KERNEL_GRAVITY_SENSOR=y
CONFIG_CUSTOM_KERNEL_GRV_SENSOR=y
CONFIG_CUSTOM_KERNEL_GYROSCOPE=y
CONFIG_CUSTOM_KERNEL_IMGSENSOR="ov48bsunny_mipi_raw ov48bofilm_mipi_raw ov16a1qsunny_mipi_raw ov16a1qofilm_mipi_raw gc02m1b_mipi_raw gc5035ofilm_mipi_raw s5k4h7sunny_mipi_raw s5k4h7ofilm_mipi_raw"
CONFIG_CUSTOM_KERNEL_LCM="s6e8fc01_fhdp_vdo"
CONFIG_CUSTOM_KERNEL_LINEARACCEL_SENSOR=y
CONFIG_CUSTOM_KERNEL_MAGNETOMETER=y
CONFIG_CUSTOM_KERNEL_RV_SENSOR=y
CONFIG_CUSTOM_KERNEL_SENSOR_FUSION=y
CONFIG_CUSTOM_KERNEL_SENSORHUB=y
CONFIG_CUSTOM_KERNEL_SITUATION=y
CONFIG_CUSTOM_KERNEL_STEP_COUNTER=y
CONFIG_CUSTOM_KERNEL_UNCALI_ACC_SENSOR=y
CONFIG_CUSTOM_KERNEL_UNCALI_GYRO_SENSOR=y
CONFIG_CUSTOM_KERNEL_UNCALI_MAG_SENSOR=y
CONFIG_DEBUG_FS=y
CONFIG_DEBUG_INFO=y
CONFIG_DEFAULT_USE_ENERGY_AWARE=y
CONFIG_DEVPTS_MULTIPLE_INSTANCES=y
CONFIG_DM_CRYPT=y
CONFIG_DM_DEFAULT_KEY=y
CONFIG_DM_THIN_PROVISIONING=y
CONFIG_DM_UEVENT=y
CONFIG_DM_VERITY_FEC=y
CONFIG_DMA_MTK_UART=y
CONFIG_DMADEVICES=y
CONFIG_DRM_I915=y
CONFIG_DRM_I915_GVT=y
CONFIG_DRM_I915_GVT_KVMGT=y
CONFIG_DRM_MEDIATEK_BOMB=y
CONFIG_DRM_MEDIATEK=y
CONFIG_DRM_PANEL_SAMSUNG_S6E8FC01=y
CONFIG_DRM=y
CONFIG_DUAL_ROLE_USB_INTF=y
CONFIG_DUMMY=y
CONFIG_DYNAMIC_DEBUG=y
CONFIG_ENABLE_DEFAULT_TRACERS=y
CONFIG_ENCRYPTED_KEYS=y
CONFIG_EPOLL=y
CONFIG_EVENTFD=y
CONFIG_EXT3_FS_POSIX_ACL=y
CONFIG_EXT3_FS_SECURITY=y
CONFIG_EXT3_FS_XATTR=y
CONFIG_EXT3_FS=y
CONFIG_EXT4_FS_POSIX_ACL=y
CONFIG_EXT4_FS_SECURITY=y
CONFIG_EXT4_FS=y
CONFIG_EXTCON_MTK_USB=y
CONFIG_EXTRA_FIRMWARE_DIR="firmware"
CONFIG_EXTRA_FIRMWARE="valhall-1691526.wa"
CONFIG_FAIR_GROUP_SCHED=y
CONFIG_FAULT_INJECTION=y
CONFIG_FB_MODE_HELPERS=y
CONFIG_FB_TILEBLITTING=y
CONFIG_FHANDLE=y
CONFIG_FRAME_WARN=3600
CONFIG_FS_ENCRYPTION_INLINE_CRYPT=y
CONFIG_FUSE_FS=y
CONFIG_GOODIX_FINGERPRINT=y
CONFIG_HAS_IOMEM=y
CONFIG_HAVE_KPROBES=y
CONFIG_HAVE_KVM=y
CONFIG_HAVE_KVM_ARCH_TLB_FLUSH_ALL=y
CONFIG_HAVE_KVM_CPU_RELAX_INTERCEPT=y
CONFIG_HAVE_KVM_EVENTFD=y
CONFIG_HAVE_KVM_INVALID_WAKEUPS=y
CONFIG_HAVE_KVM_IRQ_BYPASS=y
CONFIG_HAVE_KVM_IRQ_ROUTING=y
CONFIG_HAVE_KVM_IRQCHIP=y
CONFIG_HAVE_KVM_IRQFD=y
CONFIG_HAVE_KVM_MSI=y
CONFIG_HID_A4TECH=y
CONFIG_HID_APPLE=y
CONFIG_HID_BELKIN=y
CONFIG_HID_CHERRY=y
CONFIG_HID_CHICONY=y
CONFIG_HID_CYPRESS=y
CONFIG_HID_DRAGONRISE=y
CONFIG_HID_EZKEY=y
CONFIG_HID_GREENASIA=y
CONFIG_HID_GYRATION=y
CONFIG_HID_KENSINGTON=y
CONFIG_HID_KYE=y
CONFIG_HID_LOGITECH=y
CONFIG_HID_MAGICMOUSE=y
CONFIG_HID_MICROSOFT=y
CONFIG_HID_MONTEREY=y
CONFIG_HID_PANTHERLORD=y
CONFIG_HID_PETALYNX=y
CONFIG_HID_SAMSUNG=y
CONFIG_HID_SMARTJOYPLUS=y
CONFIG_HID_SUNPLUS=y
CONFIG_HID_THRUSTMASTER=y
CONFIG_HID_TOPSEED=y
CONFIG_HID_TWINHAN=y
CONFIG_HID_ZEROPLUS=y
CONFIG_HIDRAW=y
CONFIG_HIGH_RES_TIMERS=y
CONFIG_HUGETLBFS=y
CONFIG_HYPERVISOR_GUEST=y
CONFIG_I2C_MTK=y
CONFIG_I2C_STATUS_FOR_TOUCH=y
CONFIG_IFB=y
CONFIG_IIO_BUFFER=y
CONFIG_IIO_KFIFO_BUF=y
CONFIG_IIO=y
CONFIG_IKHEADERS=m
CONFIG_INCREMENTAL_FS=y
CONFIG_INET_DIAG=y
CONFIG_INET_ESP=y
CONFIG_INET_XFRM_MODE_TRANSPORT=y
CONFIG_INET=y
CONFIG_INET6_ESP=y
CONFIG_INET6_IPCOMP=y
CONFIG_INPUT_JOYSTICK=y
CONFIG_INPUT_MISC=y
CONFIG_INPUT_TOUCHSCREEN=y
CONFIG_INPUT_UINPUT=y
CONFIG_ION=y
CONFIG_IOSCHED_CFQ=y
CONFIG_IP_NF_FILTER=y
CONFIG_IP_NF_IPTABLES=y
CONFIG_IP_NF_NAT=y
CONFIG_IP_NF_TARGET_MASQUERADE=y
CONFIG_IP_NF_TARGET_NETMAP=y
CONFIG_IP_NF_TARGET_REDIRECT=y
CONFIG_IP_SET_BITMAP_IP=y
CONFIG_IP_SET_BITMAP_IPMAC=y
CONFIG_IP_SET_BITMAP_PORT=y
CONFIG_IP_SET_HASH_IP=y
CONFIG_IP_SET_HASH_IPMAC=y
CONFIG_IP_SET_HASH_IPMARK=y
CONFIG_IP_SET_HASH_IPPORT=y
CONFIG_IP_SET_HASH_IPPORTIP=y
CONFIG_IP_SET_HASH_IPPORTNET=y
CONFIG_IP_SET_HASH_MAC=y
CONFIG_IP_SET_HASH_NET=y
CONFIG_IP_SET_HASH_NETIFACE=y
CONFIG_IP_SET_HASH_NETNET=y
CONFIG_IP_SET_HASH_NETPORT=y
CONFIG_IP_SET_HASH_NETPORTNET=y
CONFIG_IP_SET_LIST_SET=y
CONFIG_IP_SET_MAX=256
CONFIG_IP_SET=y
CONFIG_IP_VS_NFCT=y
CONFIG_IP_VS_PROTO_TCP=y
CONFIG_IP_VS_PROTO_UDP=y
CONFIG_IP_VS_RR=y
CONFIG_IP_VS=y
CONFIG_IP6_NF_TARGET_MASQUERADE=y
CONFIG_IPC_NS=y
CONFIG_IPV6_GRE=y
CONFIG_IPV6_MIP6=y
CONFIG_IPV6_MULTIPLE_TABLES=y
CONFIG_IPV6_OPTIMISTIC_DAD=y
CONFIG_IPV6_ROUTE_INFO=y
CONFIG_IPV6_ROUTER_PREF=y
CONFIG_IPV6_VTI=y
CONFIG_IPV6=y
CONFIG_IPVLAN=y
CONFIG_IRQ_BYPASS_MANAGER=y
CONFIG_ISO9660_FS=y
CONFIG_JOLIET=y
CONFIG_JOYSTICK_XPAD_FF=y
CONFIG_JOYSTICK_XPAD_LEDS=y
CONFIG_JOYSTICK_XPAD=y
CONFIG_KEY_DH_OPERATIONS=y
CONFIG_KEYBOARD_MTK=y
CONFIG_KEYS=y
CONFIG_KPD_PWRKEY_USE_PMIC=y
CONFIG_KPROBE_EVENTS=y
CONFIG_KPROBES=y
CONFIG_KVM=y
CONFIG_KVM_AMD=y
CONFIG_KVM_ASYNC_PF=y
CONFIG_KVM_ASYNC_PF_SYNC=y
CONFIG_KVM_COMPAT=y
CONFIG_KVM_DEBUG_FS=y
CONFIG_KVM_GENERIC_DIRTYLOG_READ_PROTECT=y
CONFIG_KVM_GUEST=y
CONFIG_KVM_INTEL=y
CONFIG_KVM_MMIO=y
CONFIG_KVM_MMU_AUDIT=y
CONFIG_KVM_VFIO=y
CONFIG_LAST_TOUCH_EVENTS=y
CONFIG_LCM_HEIGHT="2400"
CONFIG_LEDS_CLASS=y
CONFIG_LEDS_MTK_DISP=y
CONFIG_LEDS_PWM=y
CONFIG_LEDS_TRIGGER_TIMER=y
CONFIG_LEDS_TRIGGERS=y
CONFIG_LEGACY_PTY_COUNT=16
CONFIG_LOCALVERSION_AUTO=y
CONFIG_LOG_BUF_SHIFT=21
CONFIG_LOGO=y
CONFIG_MACH_MT6873=y
CONFIG_MACVLAN=y
CONFIG_MAILBOX=y
CONFIG_MD=y
CONFIG_MEDIA_CAMERA_SUPPORT=y
CONFIG_MEDIA_SUPPORT=y
CONFIG_MEDIATEK_MC=y
CONFIG_MEDIATEK_MT6577_AUXADC=y
CONFIG_MEDIATEK_SOLUTION=y
CONFIG_MEMCG_KMEM=y
CONFIG_MEMCG_SWAP_ENABLED=y
CONFIG_MEMCG_SWAP=y
CONFIG_MEMCG=y
CONFIG_MFD_MT6358=y
CONFIG_MFD_MT6360_PMU=y
CONFIG_MICROTRUST_TEE_SUPPORT=y
CONFIG_MMC_BLOCK_MINORS=32
CONFIG_MMC_CRYPTO=y
CONFIG_MMC_MTK_PRO=y
CONFIG_MMC=y
CONFIG_MMU_NOTIFIER=y
CONFIG_MODULE_SRCVERSION_ALL=y
CONFIG_MSDOS_FS=y
CONFIG_MT6358_MISC=y
CONFIG_MT635X_AUXADC=y
CONFIG_MT6360_LDO=y
CONFIG_MT6360_PMIC=y
CONFIG_MT6360_PMU_CHARGER=y
CONFIG_MT6360_PMU_FLED=y
CONFIG_MT6360_PMU_RGBLED=y
CONFIG_MTD_BLOCK=y
CONFIG_MTD=y
CONFIG_MTK_AAL_SUPPORT=y
CONFIG_MTK_ACCDET=y
CONFIG_MTK_ACCELHUB=y
CONFIG_MTK_AEE_FEATURE=y
CONFIG_MTK_ALSPSHUB=y
CONFIG_MTK_ANDROID_DEFAULT_SETTING=y
CONFIG_MTK_APUSYS_DEBUG=y
CONFIG_MTK_APUSYS_EDMA_SUPPORT=y
CONFIG_MTK_APUSYS_MDLA_SUPPORT=y
CONFIG_MTK_APUSYS_RT_SUPPORT=y
CONFIG_MTK_APUSYS_SUPPORT=y
CONFIG_MTK_AUDIODSP_SUPPORT=y
CONFIG_MTK_AURISYS_PHONE_CALL_SUPPORT=y
CONFIG_MTK_BAROHUB=y
CONFIG_MTK_BTIF=y
CONFIG_MTK_CAM_CAL=y
CONFIG_MTK_CAM_SECURITY_SUPPORT=y
CONFIG_MTK_CAMERA_ISP_DPE_SUPPORT=y
CONFIG_MTK_CAMERA_ISP_FD_SUPPORT=y
CONFIG_MTK_CAMERA_ISP_MFB_SUPPORT=y
CONFIG_MTK_CAMERA_ISP_OWE_SUPPORT=y
CONFIG_MTK_CAMERA_ISP_RSC_SUPPORT=y
CONFIG_MTK_CAMERA_ISP_TSF_SUPPORT=y
CONFIG_MTK_CAMERA_ISP_WPE_SUPPORT=y
CONFIG_MTK_CCU=y
CONFIG_MTK_CHARGER_BOMB=y
CONFIG_MTK_CHARGER=y
CONFIG_MTK_CHIP=y
CONFIG_MTK_CM_MGR=y
CONFIG_MTK_CMDQ_MBOX_EXT=y
CONFIG_MTK_CMDQ_MBOX=y
CONFIG_MTK_CMDQ=y
CONFIG_MTK_COMBO_BT=y
CONFIG_MTK_COMBO_CHIP_CONSYS_6873=y
CONFIG_MTK_COMBO_GPS=y
CONFIG_MTK_COMBO_WIFI=y
CONFIG_MTK_COMBO=y
CONFIG_MTK_CONNSYS_DEDICATED_LOG_PATH=y
CONFIG_MTK_CPU_CTRL_CFP=y
CONFIG_MTK_CPU_FREQ=y
CONFIG_MTK_DEVICE_ORIENTATION_HUB=y
CONFIG_MTK_DHCPV6C_WIFI=y
CONFIG_MTK_DISP_GAME_PQ_SUPPORT=y
CONFIG_MTK_DRAM_LOG_STORE_ADDR=0x0011DF00
CONFIG_MTK_DRAM_LOG_STORE_SIZE=0x100
CONFIG_MTK_DRAM_LOG_STORE=y
CONFIG_MTK_DRE30_SUPPORT=y
CONFIG_MTK_EARA_THERMAL=y
CONFIG_MTK_ECCCI_C2K=y
CONFIG_MTK_ECCCI_DRIVER=y
CONFIG_MTK_EMMC_CACHE=y
CONFIG_MTK_EMMC_HW_CQ=y
CONFIG_MTK_EMMC_SUPPORT_OTP=y
CONFIG_MTK_EMMC_SUPPORT=y
CONFIG_MTK_ENABLE_GENIEZONE=y
CONFIG_MTK_EXTERNAL_CHARGER_TYPE_DETECT=y
CONFIG_MTK_FINGERPRINT_SUPPORT=y
CONFIG_MTK_FLASHLIGHT_DLPT=y
CONFIG_MTK_FLASHLIGHT_MT6360=y
CONFIG_MTK_FLASHLIGHT_PT_STRICT=y
CONFIG_MTK_FLASHLIGHT_PT=y
CONFIG_MTK_FLASHLIGHT=y
CONFIG_MTK_FM_CHIP="MT6635_FM"
CONFIG_MTK_FMRADIO=y
CONFIG_MTK_FPSGO_V3=y
CONFIG_MTK_FREQ_HOPPING=y
CONFIG_MTK_GAUGE_VERSION=30
CONFIG_MTK_GBE=y
CONFIG_MTK_GLGHUB=y
CONFIG_MTK_GPS_EMI=y
CONFIG_MTK_GPS_SUPPORT=y
CONFIG_MTK_GPT_SCHEME_SUPPORT=y
CONFIG_MTK_GPU_COMMON_DVFS_SUPPORT=y
CONFIG_MTK_GPU_SUPPORT=y
CONFIG_MTK_GPU_SWPM_SUPPORT=y
CONFIG_MTK_GPU_VERSION="mali valhall r25p0"
CONFIG_MTK_GYROHUB=y
CONFIG_MTK_GZ_SUPPORT_SDSP=y
CONFIG_MTK_HDR_VIDEO_SUPPORT=y
CONFIG_MTK_HWMON=y
CONFIG_MTK_IDLE_BALANCE_ENHANCEMENT=y
CONFIG_MTK_IMGSENSOR=y
CONFIG_MTK_IOMMU_PGTABLE_EXT=34
CONFIG_MTK_IOMMU_V2=y
CONFIG_MTK_ION=y
CONFIG_MTK_IPI=y
CONFIG_MTK_IRTX_PWM_SUPPORT=y
CONFIG_MTK_KERNEL_POWER_OFF_CHARGING=y
CONFIG_MTK_LCM_PHYSICAL_ROTATION="0"
CONFIG_MTK_LEDS=y
CONFIG_MTK_LENS=y
CONFIG_MTK_LOAD_TRACKER=y
CONFIG_MTK_LOWMEM_HINT=y
CONFIG_MTK_MAGHUB=y
CONFIG_MTK_MBOX=y
CONFIG_MTK_MCIF_WIFI_SUPPORT=y
CONFIG_MTK_MD1_SUPPORT=25
CONFIG_MTK_MDDP_SUPPORT=y
CONFIG_MTK_MFD_SPMI_PMIC=y
CONFIG_MTK_MOTION_DETECT_HUB=y
CONFIG_MTK_NFC_CLKBUF_ENABLE=n
CONFIG_MTK_PERF_OBSERVER=y
CONFIG_MTK_PERF_TRACKER=y
CONFIG_MTK_PICKUPHUB=y
CONFIG_MTK_PLATFORM="mt6873"
CONFIG_MTK_PMIC_CHIP_MT6359P=y
CONFIG_MTK_PMIC_COMMON=y
CONFIG_MTK_PMIC_NEW_ARCH=y
CONFIG_MTK_PMIC_WRAP=y
CONFIG_MTK_PMIF=y
CONFIG_MTK_PQ_COLOR_MODE="DISP"
CONFIG_MTK_PSEUDO_M4U=y
CONFIG_MTK_PTPOD_GPU=y
CONFIG_MTK_PTPOD=y
CONFIG_MTK_PWM=y
CONFIG_MTK_RAM_CONSOLE=y
CONFIG_MTK_RESYM=y
CONFIG_MTK_ROUND_CORNER_SUPPORT=y
CONFIG_MTK_RPMSG_MBOX=y
CONFIG_MTK_RTC=y
CONFIG_MTK_SCHED_BOOST=y
CONFIG_MTK_SCHED_CPULOAD=y
CONFIG_MTK_SCHED_EAS_POWER_SUPPORT=y
CONFIG_MTK_SCHED_RQAVG_KS=y
CONFIG_MTK_SCHED_RQAVG_US=y
CONFIG_MTK_SCHED_TRACERS=y
CONFIG_MTK_SEC_VIDEO_PATH_SUPPORT=y
CONFIG_MTK_SENSOR_ARCHITECTURE="2.0"
CONFIG_MTK_SENSOR_SUPPORT=y
CONFIG_MTK_SIB_USB_SWITCH=y
CONFIG_MTK_SKB_OWNER=y
CONFIG_MTK_SLBC=y
CONFIG_MTK_SMI_EXT=y
CONFIG_MTK_SPMTWAM=y
CONFIG_MTK_STATHUB=y
CONFIG_MTK_STATIC_POWER=y
CONFIG_MTK_STEPSIGNHUB=y
CONFIG_MTK_SYNC=y
CONFIG_MTK_TASK_TURBO=y
CONFIG_MTK_TEE_GP_SUPPORT=y
CONFIG_MTK_THERMAL_PA_VIA_ATCMD=y
CONFIG_MTK_TILTDETECTHUB=y
CONFIG_MTK_TIMER_TIMESYNC=y
CONFIG_MTK_TINYSYS_MCUPM_SUPPORT=y
CONFIG_MTK_TINYSYS_SCP_SUPPORT=y
CONFIG_MTK_TINYSYS_SSPM_SUPPORT=y
CONFIG_MTK_UAC_POWER_SAVING=y
CONFIG_MTK_UFS_SUPPORT=y
CONFIG_MTK_UNIFY_POWER=y
CONFIG_MTK_USB_TYPEC_U3_MUX=y
CONFIG_MTK_VIBRATOR=y
CONFIG_MTK_VOW_AMAZON_SUPPORT=n
CONFIG_MTK_VOW_BARGE_IN_SUPPORT=y
CONFIG_MTK_VOW_DUAL_MIC_SUPPORT=y
CONFIG_MTK_VOW_GVA_SUPPORT=n
CONFIG_MTK_VOW_MAX_PDK_NUMBER=1
CONFIG_MTK_VOW_SUPPORT=y
CONFIG_MTK_VPU_SUPPORT_DEBUG=y
CONFIG_MTK_VPU_SUPPORT=y
CONFIG_MTK_WAKEHUB=y
CONFIG_MTK_WATCHDOG_COMMON_V2=y
CONFIG_MTK_WATCHDOG_COMMON=y
CONFIG_MTPROF=y
CONFIG_MULTIUSER=y
CONFIG_NAMESPACES=y
CONFIG_NANOHUB_MTK_IPI=y
CONFIG_NANOHUB=y
CONFIG_NET=y
CONFIG_NET_CLS_CGROUP=y
CONFIG_NET_CORE=y
CONFIG_NET_L3_MASTER_DEV=y
CONFIG_NET_NS=y
CONFIG_NET_SCHED=y
CONFIG_NETDEVICES=y
CONFIG_NETFILTER_ADVANCED=y
CONFIG_NETFILTER_XT_MARK=y
CONFIG_NETFILTER_XT_MATCH_ADDRTYPE=y
CONFIG_NETFILTER_XT_MATCH_BPF=y
CONFIG_NETFILTER_XT_MATCH_CGROUP=y
CONFIG_NETFILTER_XT_MATCH_COMMENT=y
CONFIG_NETFILTER_XT_MATCH_CONNTRACK=y
CONFIG_NETFILTER_XT_MATCH_IPVS=y
CONFIG_NETFILTER_XT_MATCH_MULTIPORT=y
CONFIG_NETFILTER_XT_SET=y
CONFIG_NETFILTER_XT_TARGET_CHECKSUM=y
CONFIG_NETFILTER_XTABLES=y
CONFIG_NETFILTER=y
CONFIG_NETLINK_DIAG=y
CONFIG_NEW_LEDS=y
CONFIG_NF_CONNMARK_IPV4=y
CONFIG_NF_CONNTRACK_FTP=y
CONFIG_NF_CONNTRACK_IPV6=y
CONFIG_NF_CONNTRACK_TFTP=y
CONFIG_NF_CONNTRACK=y
CONFIG_NF_NAT_FTP=y
CONFIG_NF_NAT_IPV4=y
CONFIG_NF_NAT_IPV6=y
CONFIG_NF_NAT_MASQUERADE_IPV4=y
CONFIG_NF_NAT_NEEDED=y
CONFIG_NF_NAT_TFTP=y
CONFIG_NF_NAT=y
CONFIG_NF_SOCKET_IPV6=y
CONFIG_NFC_PN553_DEVICES=n
CONFIG_NFC=n
CONFIG_NL80211_TESTMODE=y
CONFIG_NLS_ASCII=y
CONFIG_NLS_CODEPAGE_437=y
CONFIG_NLS_CODEPAGE_950=y
CONFIG_NLS_ISO8859_1=y
CONFIG_NLS_UTF8=y
CONFIG_NONLINEAR_FREQ_CTL=y
CONFIG_NOP_USB_XCEIV=y
CONFIG_NR_CPUS=8
CONFIG_NXP_P73_DEVICES=n
CONFIG_OF=y
CONFIG_ONEKEY_REBOOT_NORMAL_MODE=y
CONFIG_ONEKEY_REBOOT_OTHER_MODE=y
CONFIG_ONEWIRE_GPIO=y
CONFIG_OVERLAY_FS=y
CONFIG_PACKET_DIAG=y
CONFIG_PANIC_ON_OOPS_VALUE=0
CONFIG_PANIC_ON_OOPS=y
CONFIG_PANIC_TIMEOUT=1
CONFIG_PARAVIRT=y
CONFIG_PARAVIRT_CLOCK=y
CONFIG_PERF_EVENTS=y
CONFIG_PERSISTENT_KEYRINGS=y
CONFIG_PHY_MTK_USB=y
CONFIG_PID_NS=y
CONFIG_POSIX_MQUEUE=y
CONFIG_PPP_ASYNC=y
CONFIG_PPP_FILTER=y
CONFIG_PPP_MULTILINK=y
CONFIG_PPP_SYNC_TTY=y
CONFIG_PPPOE=y
CONFIG_PREEMPT_NOTIFIERS=y
CONFIG_PREEMPT=y
CONFIG_PRINTK_TIME=y
CONFIG_PROC_PID_CPUSET=y
CONFIG_PSTORE_CONSOLE=y
CONFIG_PSTORE_PMSG=y
CONFIG_PSTORE_RAM=y
CONFIG_PSTORE=y
CONFIG_PTP_1588_CLOCK=y
CONFIG_PTP_1588_CLOCK_KVM=y
CONFIG_PWM_MTK_DISP=y
CONFIG_PWM=y
CONFIG_QUOTA_NETLINK_INTERFACE=y
CONFIG_RANDOMIZE_BASE=y
CONFIG_RCU_CPU_STALL_TIMEOUT=10
CONFIG_REGULATOR_FAN53870=y
CONFIG_REGULATOR_MT6315=y
CONFIG_REGULATOR_MT6359P=y
CONFIG_REGULATOR=y
CONFIG_RESOURCE_COUNTERS=y
CONFIG_RPMSG_MTK=y
CONFIG_RT_GROUP_SCHED=y
CONFIG_RTC_DRV_MT6358=y
CONFIG_SCHED_HMP=y
CONFIG_SCHED_MC=y
CONFIG_SCHED_TUNE=y
CONFIG_SCHEDSTATS=y
CONFIG_SCSI_SCAN_ASYNC=y
CONFIG_SCSI_SKHPB=y
CONFIG_SCSI_UFS_CRYPTO=y
CONFIG_SCSI_UFSHCD_PLATFORM=y
CONFIG_SCSI_UFSHCD=y
CONFIG_SCSI=y
CONFIG_SDCARD_FS=y
CONFIG_SECCOMP_FILTER=y
CONFIG_SECCOMP=y
CONFIG_SECURITY_APPARMOR=y
CONFIG_SECURITY_SELINUX_BOOTPARAM=y
CONFIG_SECURITY_SELINUX_DEVELOP=y
CONFIG_SECURITY_SELINUX=y
CONFIG_SERIAL_8250_CONSOLE=y
CONFIG_SERIAL_8250_MT6577=y
CONFIG_SERIAL_8250_NR_UARTS=2
CONFIG_SERIAL_8250_RUNTIME_UARTS=2
CONFIG_SERIAL_8250=y
CONFIG_SIMTRAY_STATUS=y
CONFIG_SND_DEBUG_VERBOSE=y
CONFIG_SND_DEBUG=y
CONFIG_SND_DYNAMIC_MINORS=y
CONFIG_SND_HRTIMER=y
CONFIG_SND_PCM_XRUN_DEBUG=y
CONFIG_SND_SEQ_DUMMY=y
CONFIG_SND_SEQUENCER=y
CONFIG_SND_SOC_CS35L41_I2C=y
CONFIG_SND_SOC_CS35L41=y
CONFIG_SND_SOC_MT6873_MT6359=y
CONFIG_SND_SOC_MTK_AUDIO_DSP=y
CONFIG_SND_SOC_MTK_BTCVSD=y
CONFIG_SND_SOC_WM_ADSP=y
CONFIG_SND_SOC=y
CONFIG_SND_USB_AUDIO=y
CONFIG_SND_VERBOSE_PRINTK=y
CONFIG_SPI_MT65XX=y
CONFIG_SPI=y
CONFIG_SPMI=y
CONFIG_STATIC_USERMODEHELPER_PATH="/system_ext/bin/aee_core_forwarder"
CONFIG_SYN_COOKIES=y
CONFIG_SYSCTL_SYSCALL=y
CONFIG_SYSVIPC=y
CONFIG_TASK_DELAY_ACCT=y
CONFIG_TASKSTATS=y
CONFIG_TCPC_CLASS=y
CONFIG_TCPC_MT6360=y
CONFIG_THERMAL_DEFAULT_GOV_BACKWARD_COMPATIBLE=y
CONFIG_THERMAL=y
CONFIG_TMPFS=y
CONFIG_TOUCHSCREEN_FTS_FOD=y
CONFIG_TOUCHSCREEN_FTS=y
CONFIG_TOUCHSCREEN_MTK_TOUCH="GT9896S GT9886"
CONFIG_TOUCHSCREEN_XIAOMI_TOUCHFEATURE=y
CONFIG_TRACEPOINTS=y
CONFIG_TTY=y
CONFIG_UCLAMP_GROUPS_COUNT=32
CONFIG_UCLAMP_MAP_OPP=y
CONFIG_UCLAMP_TASK_GROUP=y
CONFIG_UCLAMP_TASK=y
CONFIG_UFSFEATURE=y
CONFIG_UFSHPB=y
CONFIG_UFSTW_IGNORE_GUARANTEE_BIT=y
CONFIG_UFSTW=y
CONFIG_UNIX_DIAG=y
CONFIG_UNIX98_PTYS=y
CONFIG_USB_CONFIGFS_ACM=y
CONFIG_USB_CONFIGFS_F_HID=y
CONFIG_USB_CONFIGFS_MASS_STORAGE=y
CONFIG_USB_CONFIGFS_RNDIS=y
CONFIG_USB_CONFIGFS_SERIAL=y
CONFIG_USB_GADGET_VBUS_DRAW=500
CONFIG_USB_MTU3_PLAT_PHONE=y
CONFIG_USB_MTU3=y
CONFIG_USB_POWER_DELIVERY=y
CONFIG_USB_STORAGE_ALAUDA=y
CONFIG_USB_STORAGE_CYPRESS_ATACB=y
CONFIG_USB_STORAGE_DATAFAB=y
CONFIG_USB_STORAGE_FREECOM=y
CONFIG_USB_STORAGE_ISD200=y
CONFIG_USB_STORAGE_JUMPSHOT=y
CONFIG_USB_STORAGE_KARMA=y
CONFIG_USB_STORAGE_ONETOUCH=y
CONFIG_USB_STORAGE_SDDR09=y
CONFIG_USB_STORAGE_SDDR55=y
CONFIG_USB_STORAGE_USBAT=y
CONFIG_USB_STORAGE=y
CONFIG_USB_TRANCEVIBRATOR=y
CONFIG_USB_XHCI_HCD=y
CONFIG_USB_XHCI_MTK_SUSPEND=y
CONFIG_USER_NS=y
CONFIG_USER_RETURN_NOTIFIER=y
CONFIG_UTS_NS=y
CONFIG_V4L_MEM2MEM_DRIVERS=y
CONFIG_V4L_PLATFORM_DRIVERS=y
CONFIG_VETH=y
CONFIG_VFAT_FS=y
CONFIG_VFIO_MDEV=y
CONFIG_VFIO_MDEV_DEVICE=y
CONFIG_VIDEO_MEDIATEK_JPEG=y
CONFIG_VIDEO_MEDIATEK_VCODEC=y
CONFIG_VIDEO_MEDIATEK_VCU_WO_FUSE=y
CONFIG_VIRTUALIZATION=y
CONFIG_VLAN_8021Q=y
CONFIG_VXLAN=y
CONFIG_VXLAN=y 
CONFIG_WATCHDOG=y
CONFIG_WLAN_DRV_BUILD_IN=y
CONFIG_WQ_POWER_EFFICIENT_DEFAULT=y
CONFIG_X86=y
CONFIG_X86_LOCAL_APIC=y
CONFIG_XFRM_ALGO=y
CONFIG_XFRM_MIGRATE=y
CONFIG_XFRM_USER=y
CONFIG_XFRM=y
CONFIG_XMUSB350_DET_CHG=y
CONFIG_ZISOFS=y
CONFIG_ZRAM=y
CONFIG_ZSMALLOC=y
```
